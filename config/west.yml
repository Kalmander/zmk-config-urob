## config/west.yml
```yaml
manifest:
  remotes:
    # - name: moergo-sc
    #   url-base: https://github.com/moergo-sc
    - name: darknao
      url-base: https://github.com/darknao # darknao gerði moergo útgáfu af per layer per key rgb moddinu fyrir zmk
    - name: urob
      url-base: https://github.com/urob
  projects:
    - name: zmk
      remote: darknao
      # remote: moergo-sc
      # revision: main
      # revision: v25.04-beta.1
      revision: rgb-layer-25.08 # 25.08 hjá moergo svarar til v0.3.0 hjá zmk
      import: app/west.yml
    - name: zmk-auto-layer
      remote: urob
      revision: v0.3.0
      # revision: v0.2.1
    - name: zmk-adaptive-key
      remote: urob
      # revision: v0.2.1
      # revision: v0.3.0
      # Pinned past v0.3.0 to include adaptive-key fixes from main
      # (notably dead-key roll handling and global last-key state).
      revision: 18cc2795a64ccb394d1a7b7d591a5bfe3f25924b
    - name: zmk-tri-state
      remote: urob
      # revision: v0.2.1
      revision: v0.3.0
    - name: zmk-helpers
      remote: urob
      # revision: v0.2.1
      revision: v0.3.0
    - name: zmk-unicode
      remote: urob
      revision: v0.3 # set to same as ZMK version above

  self:
    path: config
```
