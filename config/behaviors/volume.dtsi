/ {
	behaviors {

		volume_up: volume_up {
				compatible = "zmk,behavior-tri-state";
				#binding-cells = <0>;
				bindings = <&cto FUNCTIONS>, <&kp C_VOL_UP>, <&to BASE>;
				ignored-key-positions = <73 74>;
				ignored-layers = <FUNCTIONS>;
		};

		volume_down: volume_down {
				compatible = "zmk,behavior-tri-state";
				#binding-cells = <0>;
				bindings = <&cto FUNCTIONS>, <&kp C_VOL_DN>, <&to BASE>;
				ignored-key-positions = <73 74>;
				ignored-layers = <FUNCTIONS>;
		};

	};
};
